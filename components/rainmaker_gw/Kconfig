## components/rainmaker_gw/Kconfig
```kconfig
# SPDX-FileCopyrightText: 2025-2026 Evgenij Cjura and project contributors
# SPDX-License-Identifier: AGPL-3.0-or-later
menu "ZHAC RainMaker bridge"

config ZHAC_RAINMAKER_ENABLE
    bool "Enable ESP RainMaker uplink bridge"
    default n
    help
        Compile the rainmaker_gw component's real bridge logic and pull the
        espressif/esp_rainmaker managed dependency (rules-gated in
        main/idf_component.yml, so a flag-off build resolves zero new
        components / managed_components entries). OFF (default):
        rainmaker_gw's public API compiles to inert stubs that always
        report RMK_ST_DISABLED — no esp_rainmaker code is linked.

        Also requires the runtime uplink selector (zap_store's
        zhac_uplink_get()) to be set to RainMaker before the bridge
        actually does anything; this flag alone only controls what gets
        COMPILED.

config ZHAC_RAINMAKER_NODE_NAME
    string "RainMaker node name"
    depends on ZHAC_RAINMAKER_ENABLE
    default "ZHAC"
    help
        Node name reported to the RainMaker cloud during claim/provisioning
        (Task 13+).

config ZHAC_RMK_MIN_REPORT_INTERVAL_S
    int "Minimum seconds between RainMaker reports for a continuous param"
    depends on ZHAC_RAINMAKER_ENABLE
    default 30
    range 5 600
    help
        Rate-limit for the bridge OUT direction on CONTINUOUS (non-boolean)
        params — temperature, humidity, brightness, colour temperature. A
        Zigbee sensor can report several times per second, but RainMaker's
        MQTT budget only refills one publish token every 5 seconds (and the
        public cloud deactivates nodes exceeding ~25,000 messages/day). Left
        unthrottled, a chatty sensor drains the budget so command reports
        (socket toggles etc.) get silently dropped — the exact "changes do
        not apply on the RainMaker side" failure this guards against.

        Only continuous params are throttled: boolean events (on/off,
        occupancy, contact) and user commands (which set `force`) always
        report immediately. Raise this if you bridge many continuous sensors;
        lower it (min 5 s) if you need fresher telemetry and publish little
        else. This does not affect the LAN Web UI, which is never throttled.

endmenu
```

## main/Kconfig.projbuild
```kconfig
# SPDX-FileCopyrightText: 2025-2026 Evgenij Cjura and project contributors
# SPDX-License-Identifier: AGPL-3.0-or-later
menu "ZHAC WiFi"

# Removed 2026-04-20: compile-time WIFI_SSID / WIFI_PASSWORD were a
# foot-gun — a user overriding WIFI_PASSWORD in sdkconfig.defaults
# baked their home WiFi password into every build artefact (and every
# core dump). Credentials now come exclusively from runtime
# provisioning: first boot comes up as an AP, user POSTs to
# /api/wifi with SSID+password, creds persist in NVS. See
# components/wifi_mgr/ + rest_ops.cpp::handle_post_wifi.

config WIFI_MAX_RETRIES
    int "Max reconnect attempts before reboot"
    default 10
    help
        Number of consecutive failed connect attempts before the device reboots.

config ZHAC_WIFI_RESET_GPIO
    int "WiFi reset button GPIO"
    default 0
    help
        GPIO pin for WiFi credential reset. Hold for 5 seconds to erase
        WiFi credentials and reboot into AP mode. Default GPIO0 is the
        BOOT button on most ESP32-S3 modules (active-low, internal pull-up).

endmenu

menu "ZHAC Security"

config ZHAC_CORS_WILDCARD
    bool "Emit 'Access-Control-Allow-Origin: *' on REST responses"
    default n
    help
        Permit cross-origin browser requests from any origin. Intended
        for local development (e.g. a vite dev server hitting the
        device API). Disable in production images: with auth disabled
        or a token leak, any web page can drive the controller.
        When unset, REST responses omit the Access-Control-Allow-Origin
        header, forcing same-origin access only (the WebUI shipped on
        the device).

config ZHAC_API_AUTH_DEFAULT_ENABLED
    bool "Require REST/WebSocket API auth by default (fresh NVS)"
    default y
    help
        Secure-by-default: on a unit with no stored auth preference (fresh
        NVS / first boot) the REST + WebSocket API require a token. A value
        the operator later sets via the WebUI (Settings) or
        /api/system/token/rotate is stored in NVS and always overrides this
        default, so toggling auth off in the UI survives reboots and updates.

        Disable (n) ONLY for a deliberately open development image. With auth
        off, any LAN/RF client has full unauthenticated control — including
        firmware OTA, Zigbee network reset, and Lua script execution (RCE).

config ZHAC_DEFAULT_API_TOKEN
    string "Bootstrap API token (32 hex chars, empty = random per device)"
    default ""
    help
        Optional build-time seed for the API token, used on first boot when
        NVS has none. Must be EXACTLY 32 hexadecimal characters — the API
        token format — e.g. `openssl rand -hex 16`. An empty or invalid value
        falls back to a unique random token generated on the device and
        printed to the serial console at first boot.

        Leave EMPTY in the public sdkconfig.defaults. A shared, committed
        token bakes one credential into every build artefact and core dump —
        the same foot-gun that retired compile-time WIFI_PASSWORD. Set a known
        value ONLY in a private, per-fleet sdkconfig.prod.defaults (e.g. a
        product line shipping a known bootstrap credential on a label that the
        operator changes on first login). Rotate it any time from the WebUI.

endmenu

menu "ZHAC Remote"

config ZHAC_REMOTE_CLIENT_ENABLE
    bool "Enable Remote WSS client (premium feature)"
    default n
    help
        Compile + link the remote_client component. Premium pay
        feature. OFF (default): zero flash + zero RAM contribution.
        The mirror call in ws_event_broadcast compiles to nothing.

config ZHAC_REMOTE_RX_BUF_KB
    int "Remote RX buffer (KB, PSRAM)"
    depends on ZHAC_REMOTE_CLIENT_ENABLE
    default 8
    range 4 32

config ZHAC_REMOTE_TX_QUEUE_DEPTH
    int "Remote TX queue depth (events)"
    depends on ZHAC_REMOTE_CLIENT_ENABLE
    default 16
    range 4 64

config ZHAC_REMOTE_PING_INTERVAL_S
    int "WSS ping interval (s)"
    depends on ZHAC_REMOTE_CLIENT_ENABLE
    default 20
    range 5 120

config ZHAC_REMOTE_BACKOFF_MAX_S
    int "Reconnect backoff cap (s)"
    depends on ZHAC_REMOTE_CLIENT_ENABLE
    default 60
    range 5 600

config ZHAC_REMOTE_ALLOW_PRIVILEGED
    bool "Allow the cloud channel to invoke privileged commands"
    depends on ZHAC_REMOTE_CLIENT_ENABLE
    default n
    help
        FINDINGS.md F9. When OFF (default) the remote/cloud channel cannot
        invoke firmware flash (ota.s3/ota.p4), network reset (zigbee.reset),
        arbitrary Lua (script.run/script.write), device deletion, settings
        changes, or token rotation — a compromised or spoofed cloud peer is
        limited to reads + recoverable device/rule/group operations. Enable
        ONLY if you fully trust the cloud endpoint and transport.

endmenu
```

## sdkconfig.defaults
```kconfig
CONFIG_IDF_TARGET="esp32s3"
CONFIG_FREERTOS_HZ=1000
CONFIG_ESP_TASK_WDT_EN=y
CONFIG_ESP_TASK_WDT_TIMEOUT_S=10
CONFIG_ESP_TASK_WDT_CHECK_IDLE_TASK_CPU0=n
CONFIG_SPIRAM=y
CONFIG_SPIRAM_MODE_OCT=y
CONFIG_ESPTOOLPY_FLASHSIZE_16MB=y
CONFIG_PARTITION_TABLE_CUSTOM=y
CONFIG_PARTITION_TABLE_CUSTOM_FILENAME="partitions.csv"
CONFIG_HTTPD_WS_SUPPORT=y
CONFIG_ESP_COREDUMP_ENABLE_TO_FLASH=y
# F17 (FINDINGS.md): removed CONFIG_ESP_COREDUMP_DATA_FORMAT_ELF and
# _CHECKSUM_CRC32 — both are unknown symbols in IDF v6 (kconfig warned).
# Enabling coredump-to-flash auto-selects the ELF format + SHA256 checksum
# (stronger than the old CRC32 intent), so the explicit lines were ineffective.
CONFIG_ESP_BROWNOUT_DET=y
CONFIG_FREERTOS_WATCHPOINT_END_OF_STACK=y
CONFIG_COMPILER_STACK_CHECK_MODE_STRONG=y
CONFIG_FREERTOS_ISR_STACKSIZE=4192
CONFIG_ESPTOOLPY_FLASHMODE_QIO=y
CONFIG_MAIN_TASK_STACK_SIZE=4192

# Per-core CPU load telemetry (/api/status cpu_pct_c0 / cpu_pct_c1)
CONFIG_FREERTOS_GENERATE_RUN_TIME_STATS=y
CONFIG_FREERTOS_USE_TRACE_FACILITY=y

# LWIP socket pool sized for httpd (3 internal) + 9 user sockets
# (ws_server.cpp:cfg.max_open_sockets=9 + REST + MQTT)
CONFIG_LWIP_MAX_SOCKETS=16

# CPU @ 240 MHz. Pair with `input_delay_ns=50` on the SPI master device
# config (hap_master.cpp): without that delay, MISO sample timing on
# 20 cm jumper wires lands inside the slave's tristate→drive
# transition, producing silent stage-1 corruption that manifests as
# every P4→S3 NEEDS_ACK frame hitting link-dead. APB stays at 80 MHz,
# so SPI peripheral clock is unchanged.
CONFIG_ESP_DEFAULT_CPU_FREQ_MHZ_240=y
CONFIG_ESP_DEFAULT_CPU_FREQ_MHZ=240
CONFIG_ESP32S3_DEFAULT_CPU_FREQ_240=y
CONFIG_ESP32S3_DEFAULT_CPU_FREQ_MHZ=240

# Performance tuning. Defaults below trade ~150 KB flash + ~32 KB IRAM
# for ~10-30% wins across CPU, network, and ZHC-registry path latency.
# Audit notes in commit message.
CONFIG_COMPILER_OPTIMIZATION_PERF=y
CONFIG_MBEDTLS_COMPILER_OPTIMIZATION_PERF=y
CONFIG_LWIP_IRAM_OPTIMIZATION=y
CONFIG_ESP_WIFI_IRAM_OPT=y
CONFIG_ESP_WIFI_RX_IRAM_OPT=y
# Cache enlargement (32K I, 64K D, 8WAYS, 64B line) reverted: empirically
# broke HAP-over-SPI on this build — SPI master DMA buffer fell back
# to non-DMA-capable memory after the +48 KB internal-SRAM hit, causing
# silent stage-1 corruption on every NEEDS_ACK frame. Defaults restored
# (16K I, 32K D). Re-evaluate only with a clear path to growing internal
# SRAM headroom (e.g. moving non-DMA buffers to PSRAM).
CONFIG_LWIP_TCP_SND_BUF_DEFAULT=11520
CONFIG_LWIP_TCP_WND_DEFAULT=11520
# Telegram bot HTTPS via tg_gw needs the cert bundle for esp_crt_bundle_attach.
CONFIG_MBEDTLS_CERTIFICATE_BUNDLE=y

# PSRAM placement — Octal SPIRAM @ 80 MHz on S3. Moving non-DMA, non-ISR
# scratch buffers into PSRAM frees internal SRAM headroom needed before
# the cache-enlargement experiment (line ~50) can be retried. RODATA
# move shifts string tables / const data, dropping flash MMU pressure
# during burst REST/JSON workloads.
CONFIG_SPIRAM_RODATA=y
CONFIG_SPIRAM_ALLOW_BSS_SEG_EXTERNAL_MEMORY=y

# Allow plain-HTTP firmware downloads for OTA. esp_https_ota refuses
# HTTP URLs unless this flag is set, even when the http_client_config
# has skip_cert_common_name_check enabled. ZHAC is a home-LAN
# controller — the user typically hosts binaries via
# `python3 -m http.server` on their workstation; forcing HTTPS would
# require running a TLS proxy or bundling a self-signed CA on-device.
# Production deployments wanting integrity verification should switch
# to SHA-256 (or Secure Boot v2) rather than relying on transport TLS.
CONFIG_OTA_ALLOW_HTTP=y
CONFIG_ZHAC_REMOTE_CLIENT_ENABLE=y

# ── API authentication (REPORT.md B2) ────────────────────────────────────
# Secure-by-default: a fresh unit requires an API token for REST + WebSocket.
# With the token seed left empty (below) a unique random token is generated on
# first boot and printed to the SERIAL console — read it there to provision,
# then rotate it in the WebUI. Leave CONFIG_ZHAC_DEFAULT_API_TOKEN EMPTY here:
# a shared committed token would bake one credential into every public build
# artefact. Set a known bootstrap token only in a private sdkconfig.prod.defaults
# for a fleet image.
CONFIG_ZHAC_API_AUTH_DEFAULT_ENABLED=y
CONFIG_ZHAC_DEFAULT_API_TOKEN=""

# ── RainMaker bridge (components/rainmaker_gw, Task 13) ─────────────────
# These three CONFIG_ESP_RMAKER_* symbols belong to the espressif/esp_rainmaker
# managed dependency, which is rules-gated on CONFIG_ZHAC_RAINMAKER_ENABLE
# (main/idf_component.yml; default n). They only EXIST in the Kconfig tree
# once that dependency actually resolves, so on a default (flag-off) build
# these lines match no known symbol and are silently inert — they do not
# force-enable RainMaker by themselves, and a flag-off build's sdkconfig
# stays exactly as if these lines weren't here.
# - SELF_CLAIM: esp_rainmaker's claim-type choice defaults to ASSISTED_CLAIM
#   whenever BT is enabled (true on esp32s3), so this needs an explicit
#   override. P0 Gate 2/3 proved self-claim + manual user-node mapping on
#   real hardware.
# - FACTORY_PARTITION_NAME="nvs": reuses ZHAC's existing main NVS partition
#   as the RainMaker factory credential store instead of the SDK's default
#   "fctry" partition, avoiding a partition-table change (which OTA cannot
#   deliver to units already in the field).
# - ENABLE_CHALLENGE_RESPONSE=n: defaults to y upstream, but challenge-
#   response REPLACES the traditional user-node mapping flow that
#   rainmaker_gw_assoc_start() depends on, and is incompatible with
#   self-claiming (it expects an already-claimed node going in). Must stay
#   off for this design's manual-association flow.
CONFIG_ESP_RMAKER_SELF_CLAIM=y
CONFIG_ESP_RMAKER_FACTORY_PARTITION_NAME="nvs"
CONFIG_ESP_RMAKER_ENABLE_CHALLENGE_RESPONSE=n
# ── RainMaker/TLS internal-SRAM protection (design §5, P0-soak-proven) ──
# The P0 gate-1 soak PASSED only with this exact set; without it a live
# TLS session drives internal low-water to ~6 KB (measured, Gate A first
# boot). ALWAYSINTERNAL=4096 additionally matches net-core master
# b938516 (matched A/B: +34.5 KB int_min on the shipping firmware).
CONFIG_SPIRAM_MALLOC_ALWAYSINTERNAL=4096
CONFIG_MBEDTLS_EXTERNAL_MEM_ALLOC=y
CONFIG_MBEDTLS_DYNAMIC_BUFFER=y
CONFIG_MBEDTLS_DYNAMIC_FREE_CONFIG_DATA=y
# TLS out-buffer shrink (in stays 16 K — AWS won't negotiate smaller
# fragments). Watch item: node-config JSON >4 KB relies on DYNAMIC_BUFFER.
CONFIG_MBEDTLS_SSL_OUT_CONTENT_LEN=4096
```
